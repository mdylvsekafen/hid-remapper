## firmware-bluetooth/boards/arm/promicro_nrf52840/Kconfig.board
```kconfig
# Adafruit Feather nRF52840 Express board configuration

# Copyright (c) 2020 Tobias Svehagen
# SPDX-License-Identifier: Apache-2.0

config BOARD_PROMICRO_NRF52840
	bool "ProMicro nRF52840"
	depends on SOC_NRF52840_QIAA
```

## firmware-bluetooth/boards/arm/promicro_nrf52840/Kconfig.defconfig
```kconfig
# ProMicro nRF52840 board configuration

# Copyright (c) 2020 Tobias Svehagen
# SPDX-License-Identifier: Apache-2.0

if BOARD_PROMICRO_NRF52840

config BOARD
	default "promicro_nrf52840"

config BT_CTLR
	default BT

endif # BOARD_PROMICRO_NRF52840
```
